## examples/human_face_detection/web/sdkconfig.defaults
```kconfig
# 🚀 AGGRESSIVE IRAM OPTIMIZATION SETTINGS
CONFIG_COMPILER_OPTIMIZATION_SIZE=y
CONFIG_COMPILER_OPTIMIZATION_ASSERTIONS_DISABLE=y
CONFIG_COMPILER_OPTIMIZATION_LEVEL_RELEASE=y

# Reduce IRAM usage - WiFi optimizations
CONFIG_ESP32_WIFI_IRAM_OPT=n
CONFIG_ESP32_WIFI_RX_IRAM_OPT=n
CONFIG_ESP32_WIFI_STATIC_RX_BUFFER_NUM=4
CONFIG_ESP32_WIFI_DYNAMIC_RX_BUFFER_NUM=8
CONFIG_ESP32_WIFI_STATIC_TX_BUFFER_NUM=4
CONFIG_ESP32_WIFI_DYNAMIC_TX_BUFFER_NUM=8

# Disable features to save IRAM
CONFIG_ESP_TIMER_PROFILING=n
CONFIG_ESP_ERR_TO_NAME_LOOKUP=n
CONFIG_ESP32_ENABLE_COREDUMP_TO_FLASH=n
CONFIG_ESP32_ENABLE_COREDUMP_TO_UART=n

# Reduce logging to save IRAM
CONFIG_LOG_DEFAULT_LEVEL_INFO=y
CONFIG_LOG_MAXIMUM_LEVEL=3

# Reduce task stack sizes
CONFIG_ESP_MAIN_TASK_STACK_SIZE=3072
CONFIG_ESP_SYSTEM_EVENT_TASK_STACK_SIZE=2048

# LWIP memory optimization
CONFIG_LWIP_TCP_MSS=1440
CONFIG_LWIP_TCP_SND_BUF_DEFAULT=2880
CONFIG_LWIP_TCP_WND_DEFAULT=2880
CONFIG_LWIP_TCP_RECVMBOX_SIZE=4
CONFIG_LWIP_UDP_RECVMBOX_SIZE=4
CONFIG_LWIP_TCPIP_RECVMBOX_SIZE=8

# Camera optimizations
CONFIG_CAMERA_CORE0=y
CONFIG_CAMERA_DMA_BUFFER_SIZE_MAX=32768

# Enable SPIRAM (ESP32-CAM has 64MB PSRAM)
CONFIG_ESP32_SPIRAM_SUPPORT=y
CONFIG_SPIRAM_USE_MALLOC=y
CONFIG_SPIRAM_USE_CAPS_ALLOC=y
CONFIG_SPIRAM_USE_MEMMAP=n
CONFIG_SPIRAM_TYPE_AUTO=y
CONFIG_SPIRAM_SIZE=-1
CONFIG_SPIRAM_SPEED_80M=y

# ========================================
# MBEDTLS OPTIMIZATION FOR HTTPS MEMORY
# ========================================
# Reduce SSL/TLS buffer sizes to save memory
CONFIG_MBEDTLS_SSL_MAX_CONTENT_LEN=8192
CONFIG_MBEDTLS_SSL_IN_CONTENT_LEN=8192
CONFIG_MBEDTLS_SSL_OUT_CONTENT_LEN=4096

# Disable TLS server (we only need client)
CONFIG_MBEDTLS_TLS_SERVER=n
CONFIG_MBEDTLS_TLS_CLIENT=y

# Enable TLS 1.2 (required by Railway.app)
CONFIG_MBEDTLS_SSL_PROTO_TLS1_2=y
CONFIG_MBEDTLS_SSL_PROTO_TLS1=n
CONFIG_MBEDTLS_SSL_PROTO_TLS1_1=n
CONFIG_MBEDTLS_SSL_PROTO_DTLS=n

# Use hardware acceleration for crypto
CONFIG_MBEDTLS_HARDWARE_AES=y
CONFIG_MBEDTLS_HARDWARE_SHA=y
CONFIG_MBEDTLS_HARDWARE_MPI=y

# Certificate bundle - Use FULL for Railway compatibility
# Railway uses Let's Encrypt which should be in CMN, but FULL is more reliable
CONFIG_MBEDTLS_CERTIFICATE_BUNDLE=y
CONFIG_MBEDTLS_CERTIFICATE_BUNDLE_DEFAULT_FULL=y
CONFIG_MBEDTLS_CERTIFICATE_BUNDLE_DEFAULT_CMN=n

# Disable unused TLS features
CONFIG_MBEDTLS_CLIENT_SSL_SESSION_TICKETS=n
CONFIG_MBEDTLS_SERVER_SSL_SESSION_TICKETS=n

# Optimize memory allocation
CONFIG_MBEDTLS_DYNAMIC_BUFFER=y
CONFIG_MBEDTLS_DYNAMIC_FREE_PEER_CERT=y
CONFIG_MBEDTLS_DYNAMIC_FREE_CONFIG_DATA=y

# Use external heap for mbedtls (allows using general heap instead of internal)
# This helps when internal heap is fragmented but general heap has space
CONFIG_MBEDTLS_INTERNAL_MEM_ALLOC=n
CONFIG_MBEDTLS_ASYMMETRIC_CONTENT_LEN=y
```
